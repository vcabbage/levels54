## config/west.yml
```yaml
manifest:
  defaults:
    revision: main
  remotes:
    - name: zmkfirmware
      url-base: https://github.com/zmkfirmware
    - name: vcabbage
      url-base: https://github.com/vcabbage
  projects:
    - name: zmk
      remote: zmkfirmware
      revision: 9ebbeff0a8b69a42f14aec022cdf16c7a107b9e0
      import: app/west.yml
    - name: gggw-zmk-keebs
      remote: vcabbage
      revision: custom
      import: config/west.yml
  self:
    path: config
```
